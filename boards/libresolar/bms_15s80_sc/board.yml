## boards/libresolar/bms_15s80_sc/board.yml
```yaml
board:
  name: bms_15s80_sc
  full_name: Libre Solar BMS 15S80 SC
  vendor: libresolar
  socs:
    - name: stm32f072xb
```

## boards/libresolar/bms_16s100_sc/board.yml
```yaml
board:
  name: bms_16s100_sc
  full_name: Libre Solar BMS 16S100 SC
  vendor: libresolar
  socs:
    - name: stm32g0b1xx
```

## boards/libresolar/bms_5s50_sc/board.yml
```yaml
board:
  name: bms_5s50_sc
  full_name: Libre Solar BMS 5S50 SC
  vendor: libresolar
  socs:
    - name: stm32f072xb
```

## boards/libresolar/bms_c1/board.yml
```yaml
board:
  name: bms_c1
  full_name: Libre Solar BMS C1
  vendor: libresolar
  socs:
    - name: esp32c3
  revision:
    format: major.minor.patch
    default: "0.4.0"
    revisions:
      - name: "0.4.0"
      - name: "0.3.0"
```
